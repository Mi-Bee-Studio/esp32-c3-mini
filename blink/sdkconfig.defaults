## blink/sdkconfig.defaults
```kconfig
## blink — ESP32-C3-Mini（Lolin C3 Mini）基线工程（测试固件）
# 板级信息见 ../README.zh.md；芯片 ESP32-C3FH4（4MB flash 片内封装），无 PSRAM
CONFIG_IDF_TARGET="esp32c3"

# 控制台走原生 USB-Serial-JTAG（本板无 USB-UART 桥）
CONFIG_ESP_CONSOLE_USB_SERIAL_JTAG=y

CONFIG_ESPTOOLPY_FLASHSIZE_4MB=y
CONFIG_PARTITION_TABLE_CUSTOM=y
CONFIG_PARTITION_TABLE_CUSTOM_FILENAME="partitions.csv"

# 任务看门狗超时触发 panic 重启（主循环 1s 一拍喂狗）
CONFIG_ESP_TASK_WDT_PANIC=y

# C3 单核 RISC-V 满频 160MHz
CONFIG_ESP_DEFAULT_CPU_FREQ_MHZ_160=y
CONFIG_FREERTOS_HZ=1000
```
